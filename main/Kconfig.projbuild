## main/Kconfig.projbuild
```kconfig
menu "Receiver Firmware"

choice RECEIVER_RADIO_VARIANT
    prompt "Active radio"
    default RECEIVER_RADIO_433M

config RECEIVER_RADIO_433M
    bool "433 MHz ASK/OOK receiver"

config RECEIVER_RADIO_2_4G
    bool "nRF24L01 / nRF24L01+ 2.4 GHz"

endchoice

config RECEIVER_RF433_RX_GPIO
    int "433 MHz RX GPIO"
    default 4
    depends on RECEIVER_RADIO_433M

config RECEIVER_NRF24_SCK
    int "nRF24 SCK GPIO"
    default 6
    depends on RECEIVER_RADIO_2_4G

config RECEIVER_NRF24_MOSI
    int "nRF24 MOSI GPIO"
    default 7
    depends on RECEIVER_RADIO_2_4G

config RECEIVER_NRF24_MISO
    int "nRF24 MISO GPIO"
    default 2
    depends on RECEIVER_RADIO_2_4G

config RECEIVER_NRF24_CS
    int "nRF24 CS GPIO"
    default 5
    depends on RECEIVER_RADIO_2_4G

config RECEIVER_NRF24_CE
    int "nRF24 CE GPIO"
    default 3
    depends on RECEIVER_RADIO_2_4G

config RECEIVER_NRF24_IRQ
    int "nRF24 IRQ GPIO"
    default 10
    depends on RECEIVER_RADIO_2_4G

config RECEIVER_NRF24_CHANNEL
    int "nRF24 RF channel"
    default 100
    range 97 125
    depends on RECEIVER_RADIO_2_4G
    help
        nRF24 RF channel: f = 2400 MHz + N. Must match the transmitter.

choice RECEIVER_NRF24_DATA_RATE
    prompt "nRF24 air data rate"
    default RECEIVER_NRF24_DR_1M
    depends on RECEIVER_RADIO_2_4G

config RECEIVER_NRF24_DR_1M
    bool "1 Mbps"

config RECEIVER_NRF24_DR_2M
    bool "2 Mbps"

endchoice

config RECEIVER_NRF24_ENABLE_DPL
    bool "Enable Dynamic Payload Length"
    default y
    depends on RECEIVER_RADIO_2_4G

config RECEIVER_VIBRATOR_GPIO
    int "Vibrator GPIO"
    default 1

config RECEIVER_PAIR_PSK
    string "Pairing pre-shared key (64 hex chars = 32 bytes)"
    default ""
    help
        Shared secret for HMAC-SHA256 verification during ESP-NOW
        pairing. Must be exactly 64 hexadecimal characters (32 bytes).
        Must match the transmitter hub's CONFIG_TRANSMITTER_PAIR_PSK.

config RECEIVER_PAIR_CHANNEL_SCAN_MS
    int "ESP-NOW channel scan dwell time (ms)"
    default 300
    range 100 1000
    help
        How long to listen on each WiFi channel during pairing scan.
        Full 13-channel scan takes this value x 13.

endmenu
```
